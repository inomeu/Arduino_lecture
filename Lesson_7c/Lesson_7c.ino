unsigned int i,line=0;
const char col[5]={1,3,10,7,8};
const char row[7]={12,11,2,9,4,5,6};
const char dot[10][5]={
  {0x3e,0x51,0x49,0x45,0x3e},//0
  {0x00,0x42,0x7f,0x40,0x00},//
  {0x42,0x61,0x51,0x49,0x46},//
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  {0x06,0x49,0x49,0x29,0x1e},//
};

void setup() {
  for(i=0;i<5;i++) pinMode(col[i],OUTPUT);
  for(i=0;i<7;i++) pinMode(row[i],OUTPUT);
}

int rx=0;

void loop() {
  unsigned int wk=line%5;
  
  for(i=0;i<5;i++) digitalWrite(col[i],LOW);
  
  digitalWrite(col[wk],HIGH);

  digitalWrite(12,!(dot[3][wk]&0x01));
  digitalWrite(11,!(dot[3][wk]&0x02));
  digitalWrite(2,!(dot[3][wk]&0x04));
  digitalWrite(9,!(dot[3][wk]&0x08));
  digitalWrite(4,!(dot[3][wk]&0x10));
  digitalWrite(5,!(dot[3][wk]&0x20));
  digitalWrite(6,!(dot[3][wk]&0x40));

  line++;
  delay(2);
}
